## meta-realtek-bsp/conf/machine/rtl8730eam-va6.conf
```bitbake
#@TYPE: Machine
#@NAME: Realtek RTL8730EAM-VA6 IoT Development Board
#@DESCRIPTION: Machine configuration for Realtek RTL8730EAM-VA6 IoT Development Board

require include/rtl8730e-evk.inc

IMAGE_FEATURES += " read-only-rootfs read-only-rootfs-delayed-postinsts"

IMAGE_FSTYPES += "squashfs jffs2"

KERNEL_DEVICETREE = "\
    realtek/ameba/rtl8730eam-va6-generic.dtb \
    realtek/ameba/rtl8730eam-va6-full.dtb \
"

EXTRA_IMAGEDEPENDS += "atf-ameba u-boot-ameba optee-client-ameba optee-os-ameba"

JFFS2_ENDIANNESS = "0x300000"
JFFS2_ERASEBLOCK = "0x10000"

UBOOT_MACHINE = "rtl8730eam-va6_defconfig"
UBOOT_ENTRYPOINT = "0x60388000"
```

## meta-realtek-bsp/conf/machine/rtl8730elh-va7.conf
```bitbake
#@TYPE: Machine
#@NAME: Realtek RTL8730ELH-VA7 IoT Development Board
#@DESCRIPTION: Machine configuration for Realtek RTL8730ELH-VA7 IoT Development Board

require include/rtl8730e-evk.inc

IMAGE_FEATURES += " read-only-rootfs"

KERNEL_DEVICETREE = "\
    realtek/ameba/rtl8730elh-va7-full.dtb \
    realtek/ameba/rtl8730elh-va7-generic.dtb \
    realtek/ameba/rtl8730elh-va7-tests-adc-diff.dtb \
    realtek/ameba/rtl8730elh-va7-tests-adc-sig.dtb \
    realtek/ameba/rtl8730elh-va7-tests-ctc.dtb \
    realtek/ameba/rtl8730elh-va7-tests-i2c.dtb \
    realtek/ameba/rtl8730elh-va7-tests-ir-rx.dtb \
    realtek/ameba/rtl8730elh-va7-tests-ir-tx.dtb \
    realtek/ameba/rtl8730elh-va7-tests-misc.dtb \
    realtek/ameba/rtl8730elh-va7-tests-spi.dtb \
    realtek/ameba/rtl8730elh-va7-tests-uart.dtb \
    realtek/ameba/rtl8730elh-va7-tests-display.dtb \
"

EXTRA_IMAGEDEPENDS += "atf-ameba u-boot-ameba optee-client-ameba optee-os-ameba"

MKUBIFS_ARGS = "-F -m 2048 -e 126976 -c 436 -j 380928"

UBOOT_MACHINE = "rtl8730elh-va7_defconfig"
UBOOT_ENTRYPOINT = "0x60388000"
```

## meta-realtek-bsp/conf/machine/rtl8730elm-va8.conf
```bitbake
#@TYPE: Machine
#@NAME: Realtek RTL8730ELH-VA8 IoT Development Board
#@DESCRIPTION: Machine configuration for Realtek RTL8730ELH-VA8 IoT Development Board

require include/rtl8730e-evk.inc

IMAGE_FEATURES += " read-only-rootfs"

KERNEL_DEVICETREE = "\
    realtek/ameba/rtl8730elm-va8-full.dtb \
    realtek/ameba/rtl8730elm-va8-generic.dtb \
    realtek/ameba/rtl8730elm-va8-tests-adc-diff.dtb \
    realtek/ameba/rtl8730elm-va8-tests-adc-sig.dtb \
    realtek/ameba/rtl8730elm-va8-tests-ctc.dtb \
    realtek/ameba/rtl8730elm-va8-tests-i2c.dtb \
    realtek/ameba/rtl8730elm-va8-tests-ir-rx.dtb \
    realtek/ameba/rtl8730elm-va8-tests-ir-tx.dtb \
    realtek/ameba/rtl8730elm-va8-tests-lcd.dtb \
    realtek/ameba/rtl8730elm-va8-tests-misc.dtb \
    realtek/ameba/rtl8730elm-va8-tests-spi.dtb \
    realtek/ameba/rtl8730elm-va8-tests-uart.dtb \
    realtek/ameba/rtl8730elm-va8-tests-display.dtb \
"

EXTRA_IMAGEDEPENDS += "atf-ameba u-boot-ameba optee-client-ameba optee-os-ameba"

MKUBIFS_ARGS = "-F -m 2048 -e 126976 -c 436 -j 380928"

UBOOT_MACHINE = "rtl8730elm-va8_defconfig"
```
