## meta-realtek-bsp/conf/layer.conf
```bitbake
# We have a conf and classes directory, add to BBPATH
BBPATH .= ":${LAYERDIR}"

# We have recipes-* directories, add to BBFILES
BBFILES += "${LAYERDIR}/recipes-*/*/*.bb \
            ${LAYERDIR}/recipes-*/*/*.bbappend"

BBFILE_COLLECTIONS += "realtek"
BBFILE_PATTERN_realtek = "^${LAYERDIR}/"
BBFILE_PRIORITY_realtek = "9"

LAYERDEPENDS_realtek = "core"
LAYERSERIES_COMPAT_realtek = "kirkstone"
```

## meta-realtek-bsp/conf/machine/include/rtl8730e-evk.inc
```bitbake
MACHINEOVERRIDES =. "rtl8730e:"

DEFAULTTUNE ?= "cortexa32"
include conf/machine/include/arm/armv8a/tune-cortexa32.inc

IMAGE_FSTYPES += "tar.bz2 ubi"
#MACHINE_ESSENTIAL_EXTRA_RDEPENDS += "kernel-image kernel-devicetree"
MACHINE_ESSENTIAL_EXTRA_RRECOMMENDS  += "kernel-modules"

# to remove kernel image in rootfs
RRECOMMENDS:${KERNEL_PACKAGE_NAME}-base = ""

UBI_VOLNAME ?= "rootfs"
MKUBIFS_ARGS = "-F -m 2048 -e 126976 -c 436 -j 380928"
UBINIZE_ARGS = "-m 2048 -p 131072 -s 2048 -O 2048"
UBI_IMGTYPE = "squashfs"
IMAGE_ROOTFS_ALIGNMENT = "2048"

SERIAL_CONSOLES ?= "115200;ttyS0 115200;ttyO0 115200;ttyAMA0"
#SERIAL_CONSOLES_CHECK = "${SERIAL_CONSOLES}"

PREFERRED_PROVIDER_virtual/kernel ?= "linux-ameba"
PREFERRED_VERSION_linux-yocto ?= "5.4%"

KERNEL_IMAGETYPE = "uImage"
KERNEL_EXTRA_ARGS += "LOADADDR=${UBOOT_ENTRYPOINT}"
KERNEL_DEVICETREE = "\
    rtl8730elh-va7-generic.dtb \
    rtl8730elh-va8-generic.dtb \
    rtl8730elh-va7-full.dtb \
    rtl8730elh-va8-full.dtb \
    rtl8730elh-va7-tests.dtb \
    rtl8730elh-va8-tests.dtb \
    rtl8730elh-va7-recovery.dtb \
    rtl8730elh-va8-recovery.dtb \
"

PREFERRED_PROVIDER_virtual/bootloader ?= "u-boot-ameba"

UBOOT_ENTRYPOINT = "0x60388000"

UBOOT_SUFFIX = "bin"
```

## meta-realtek-bsp/conf/machine/rtl8730eah-va6.conf
```bitbake
#@TYPE: Machine
#@NAME: Realtek RTL8730EAH-VA6 IoT Development Board
#@DESCRIPTION: Machine configuration for Realtek RTL8730EAH-VA6 IoT Development Board

require include/rtl8730e-evk.inc

IMAGE_FEATURES += " read-only-rootfs read-only-rootfs-delayed-postinsts"

IMAGE_FSTYPES += "squashfs jffs2"

KERNEL_DEVICETREE = "\
    rtl8730eah-va6-generic.dtb \
    rtl8730eah-va6-full.dtb \
"

EXTRA_IMAGEDEPENDS += "atf-ameba u-boot-ameba optee-client-ameba optee-os-ameba"

JFFS2_ENDIANNESS = "0x300000"
JFFS2_ERASEBLOCK = "0x10000"

UBOOT_MACHINE = "rtl8730eah-va6_defconfig"
```

## meta-realtek-bsp/conf/machine/rtl8730elh-recovery.conf
```bitbake
#@TYPE: Machine
#@NAME: Realtek RTL8730ELH-RECOVERY IoT Development Board
#@DESCRIPTION: Machine configuration for Realtek RTL8730ELH-RECOVERY IoT Development Board

DEFAULTTUNE ?= "cortexa32"
include conf/machine/include/arm/armv8a/tune-cortexa32.inc

IMAGE_FSTYPES += "cpio.gz"

# to remove kernel image in rootfs
RRECOMMENDS:${KERNEL_PACKAGE_NAME}-base = ""

SERIAL_CONSOLES ?= "115200;ttyS0 115200;ttyO0 115200;ttyAMA0"
SERIAL_CONSOLES_CHECK = "${SERIAL_CONSOLES}"

PREFERRED_PROVIDER_virtual/kernel ?= "linux-ameba"
PREFERRED_VERSION_linux-yocto ?= "5.4%"

KERNEL_IMAGETYPE = "uImage"
KERNEL_EXTRA_ARGS += "LOADADDR=${UBOOT_ENTRYPOINT}"
KERNEL_DEVICETREE = "\
    rtl8730eah-va6-recovery.dtb \
    rtl8730elh-va7-recovery.dtb \
    rtl8730elh-va8-recovery.dtb \
"

UBOOT_ENTRYPOINT = "0x60388000"

PRODUCT = "recovery"

INITRAMFS_IMAGE = "ameba-image-recovery"
INITRAMFS_IMAGE_BUNDLE = "1"
INIT_MANAGER ?= "mdev-busybox"

IMAGE_INSTALL += " busybox"
IMAGE_INSTALL += " recovery"
```

## meta-realtek-bsp/conf/machine/rtl8730elh-va8.conf
```bitbake
#@TYPE: Machine
#@NAME: Realtek RTL8730ELH-VA8 IoT Development Board
#@DESCRIPTION: Machine configuration for Realtek RTL8730ELH-VA8 IoT Development Board

require include/rtl8730e-evk.inc

IMAGE_FEATURES += " read-only-rootfs"

KERNEL_DEVICETREE = "\
    rtl8730elh-va8-full.dtb \
    rtl8730elh-va8-generic.dtb \
    rtl8730elh-va8-tests-adc-diff.dtb \
    rtl8730elh-va8-tests-adc-sig.dtb \
    rtl8730elh-va8-tests-ctc.dtb \
    rtl8730elh-va8-tests-i2c.dtb \
    rtl8730elh-va8-tests-ir-rx.dtb \
    rtl8730elh-va8-tests-ir-tx.dtb \
    rtl8730elh-va8-tests-lcd.dtb \
    rtl8730elh-va8-tests-misc.dtb \
    rtl8730elh-va8-tests-spi.dtb \
    rtl8730elh-va8-tests-uart.dtb \
    rtl8730elh-va8-tests-display.dtb \
"

EXTRA_IMAGEDEPENDS += "atf-ameba u-boot-ameba optee-client-ameba optee-os-ameba"

MKUBIFS_ARGS = "-F -m 2048 -e 126976 -c 436 -j 380928"

UBOOT_MACHINE = "rtl8730elh-va8_defconfig"
```

## meta-realtek-toolchain/conf/distro/include/tcmode-external-rsdk-toolchain.inc
```bitbake
#
# Configuration to use an external RSDK glibc binary toolchain wrapper
# 
# Copyright 2016-2023, Realtek Corp.
#

EXTERNAL_TOOLCHAIN ?= "UNDEFINED"

TOOLCHAIN_PATH_ADD = "${EXTERNAL_TOOLCHAIN}/bin:"
PATH =. "${TOOLCHAIN_PATH_ADD}"

RSDK_TARGET_SYS:arm = "arm-linux-gnueabi"
RSDK_TARGET_SYS:aarch64 = "aarch64-linux-gnu"
RSDK_TARGET_SYS = "${TARGET_SYS}"
TARGET_PREFIX = "${RSDK_TARGET_SYS}-"

RSDK_LIBDIR:arm = "lib"
RSDK_LIBDIR:aarch64 = "lib"
RSDK_LIBDIR = "lib"

GCCMULTILIB:forcevariable = "--disable-multilib"
IMAGE_LINGUAS:forcevariable = ""

# Blacklist toolchain recipes as a belt-and-suspenders way to use the external toolchain
SKIP_RECIPE[glibc] = "Using external toolchain"
SKIP_RECIPE[libgcc] = "Using external toolchain"
SKIP_RECIPE[gcc-cross] = "Using external toolchain"
SKIP_RECIPE[gcc-runtime] = "Using external toolchain"
SKIP_RECIPE[gcc-sanitizers] = "Using external toolchain"

PREFERRED_PROVIDER_linux-libc-headers = "external-rsdk-toolchain"
PREFERRED_PROVIDER_linux-libc-headers-dev = "external-rsdk-toolchain"
PREFERRED_PROVIDER_virtual/${TARGET_PREFIX}gcc = "external-rsdk-toolchain"
PREFERRED_PROVIDER_virtual/${TARGET_PREFIX}gcc-initial = "external-rsdk-toolchain"
PREFERRED_PROVIDER_virtual/${TARGET_PREFIX}g++ = "external-rsdk-toolchain"
PREFERRED_PROVIDER_virtual/${TARGET_PREFIX}binutils = "external-rsdk-toolchain"
PREFERRED_PROVIDER_virtual/${TARGET_PREFIX}libc-for-gcc = "external-rsdk-toolchain"
PREFERRED_PROVIDER_virtual/${TARGET_PREFIX}compilerlibs = "external-rsdk-toolchain"
PREFERRED_PROVIDER_glibc = "external-rsdk-toolchain"
PREFERRED_PROVIDER_libgcc = "external-rsdk-toolchain"
PREFERRED_PROVIDER_virtual/libc = "external-rsdk-toolchain"
PREFERRED_PROVIDER_virtual/libc-locale = "external-rsdk-toolchain"
PREFERRED_PROVIDER_virtual/libintl = "external-rsdk-toolchain"
PREFERRED_PROVIDER_virtual/libiconv = "external-rsdk-toolchain"
PREFERRED_PROVIDER_virtual/crypt = "external-rsdk-toolchain"
PREFERRED_PROVIDER_glibc-thread-db = "external-rsdk-toolchain"
PREFERRED_PROVIDER_glibc-mtrace = "external-rsdk-toolchain"
PREFERRED_PROVIDER_libc-mtrace = "external-rsdk-toolchain"
PREFERRED_PROVIDER_virtual/linux-libc-headers = "external-rsdk-toolchain"
PREFERRED_PROVIDER_binutils-cross-${TARGET_ARCH} = "external-rsdk-toolchain"


TARGET_CPPFLAGS:prepend = " -isystem${EXTERNAL_TOOLCHAIN}/${RSDK_TARGET_SYS}/include "
TARGET_LDFLAGS:prepend = " -L${EXTERNAL_TOOLCHAIN}/${RSDK_TARGET_SYS}/lib -Wl,-rpath-link,${EXTERNAL_TOOLCHAIN}/${RSDK_TARGET_SYS}/lib "

TOOLCHAIN_OPTIONS = " --sysroot=${STAGING_DIR_HOST}"

DISTRO_FEATURES_LIBC = "ipv4 ipv6 libc-backtrace libc-big-macros libc-bsd libc-cxx-tests libc-catgets libc-crypt \
			libc-crypt-ufc libc-db-aliases libc-envz libc-fcvt libc-fmtmsg libc-fstab libc-ftraverse \
			libc-getlogin libc-idn libc-inet-anl libc-libm libc-libm-big \
			libc-locales libc-locale-code libc-charsets \
			libc-memusage libc-nis libc-nsswitch libc-rcmd libc-rtld-debug libc-spawn libc-streams libc-sunrpc \
			libc-utmp libc-utmpx libc-wordexp libc-posix-clang-wchar libc-posix-regexp libc-posix-regexp-glibc \
			libc-posix-wchar-io"

ENABLE_BINARY_LOCALE_GENERATION = "0"
GLIBC_INTERNAL_USE_BINARY_LOCALE = "precompiled"
LIBCOVERRIDE = ":libc-glibc"

ERROR_QA[type] ?= "list"
python toolchain_metadata_setup () {
    import subprocess
    if not isinstance(e, bb.event.ConfigParsed):
        return

    d = e.data
    l = d.createCopy()
    l.finalize()
    oe_import(l)

    external_toolchain = l.getVar('EXTERNAL_TOOLCHAIN', True)
    if not external_toolchain or external_toolchain == 'UNDEFINED':
        bb.fatal("Error: EXTERNAL_TOOLCHAIN must be set to the path to your rsdk toolchain")

    if not os.path.exists(external_toolchain):
        bb.fatal("Error: EXTERNAL_TOOLCHAIN path '%s' does not exist" % external_toolchain)

    # The external toolchain may not have been built with the oe-core preferred
    # gnu hash setting, so ensure that the corresponding sanity check is not an error.
    error_qa = oe.data.typed_value('ERROR_QA', l)
    if 'ldflags' in error_qa:
        error_qa.remove('ldflags')
        d.setVar('ERROR_QA', ' '.join(error_qa))
}
addhandler toolchain_metadata_setup

def populate_toolchain_links(d):
    import errno
    import os
    from glob import glob

    d = d.createCopy()
    d.finalize()

    pattern = bb.data.expand('${EXTERNAL_TOOLCHAIN}/bin/${TARGET_PREFIX}*', d)
    files = glob(pattern)
    if not files:
        bb.fatal("Unable to populate toolchain binary symlinks")

    bindir = d.getVar('STAGING_BINDIR_TOOLCHAIN', True)
    bb.mkdirhier(bindir)
    for f in files:
        base = os.path.basename(f)
        newpath = os.path.join(bindir, base)
        try:
            os.symlink(f, newpath)
        except OSError as exc:
            if exc.errno == errno.EEXIST:
                break
            bb.fatal("Unable to populate toolchain binary symlink for %s: %s" % (newpath, exc))

require conf/distro/include/external-rsdk-toolchain-versions.inc
```

## meta-realtek-toolchain/conf/layer.conf
```bitbake
# We have a conf and classes directory, add to BBPATH
BBPATH .= ":${LAYERDIR}"

# We have recipes-* directories, add to BBFILES
BBFILES += "${LAYERDIR}/recipes-*/*/*.bb \
            ${LAYERDIR}/recipes-*/*/*.bbappend"

BBFILE_COLLECTIONS += "meta-realtek-toolchain"
BBFILE_PATTERN_meta-realtek-toolchain = "^${LAYERDIR}/"
BBFILE_PRIORITY_meta-realtek-toolchain = "5"

LAYERDEPENDS_meta-realtek-toolchain = "core"
LAYERSERIES_COMPAT_meta-realtek-toolchain = "kirkstone"
```

## meta-sdk/conf/distro/ameba-full.conf
```bitbake
# Ameba Distro for Full

require conf/distro/include/ameba-base.inc

DISTRO = "ameba-full"
DISTRO_NAME = "Ameba Full"

# Remove not used features
DISTRO_FEATURES:remove = "ext2 pci 3g nfc x11 opengl wayland vulkan"

DISTRO_FEATURES:append = "rtk-fwk-full gui"
```

## meta-sdk/conf/distro/ameba-generic.conf
```bitbake
# Ameba Distro for Generic

require conf/distro/include/ameba-base.inc

DISTRO = "ameba-generic"
DISTRO_NAME = "Ameba Generic"

# Remove not used features
DISTRO_FEATURES:remove = "ext2 pci 3g nfc x11 opengl wayland vulkan"

DISTRO_FEATURES:append = "rtk-fwk-generic"
```

## meta-sdk/conf/distro/include/ameba-base.inc
```bitbake
require conf/distro/poky.conf

DISTRO = "ameba-base"
DISTRO_NAME = "Realtek Ameba Distro Base"
DISTROOVERRIDES = "ameba"

MAINTAINER = "Realtek Semiconductors <ameba@realtek.com>"

SDK_VENDOR = "-rtksdk"
TARGET_VENDOR = "-rtk"

# Define Init System
INIT_MANAGER = "sysvinit"
SYSVINIT_ENABLED_GETTYS = "S0"

POKY_DEFAULT_DISTRO_FEATURES:remove = "opengl vulkan"

PREFERRED_PROVIDER_virtual/kernel = "linux-ameba"
PREFERRED_PROVIDER_virtual/bootloader = "u-boot-ameba"
```

## meta-sdk/conf/layer.conf
```bitbake
# We have a conf and classes directory, add to BBPATH
BBPATH .= ":${LAYERDIR}"

# We have recipes-* directories, add to BBFILES
BBFILES += "${LAYERDIR}/recipes-*/*/*.bb \
            ${LAYERDIR}/recipes-*/*/*.bbappend"

BBFILE_COLLECTIONS += "meta-sdk"
BBFILE_PATTERN_meta-sdk = "^${LAYERDIR}/"
BBFILE_PRIORITY_meta-sdk = "6"

LAYERDEPENDS_meta-sdk = "core"
LAYERSERIES_COMPAT_meta-sdk = "kirkstone"
```
